## conf/distro/include/rbz-imx-base.inc
```bitbake
require conf/distro/poky.conf

DISTRO = "imx-rbz"
DISTRO_NAME = "RBZ i.MX Release Distro"
DISTRO_VERSION = "5.10-hardknott"

MAINTAINER = "RBZ <info@rbz.es>"

REMOVE_VULKAN_FEATURE = "vulkan"
REMOVE_VULKAN_FEATURE_mx8 = ""
POKY_DEFAULT_DISTRO_FEATURES_remove      = "wayland ${REMOVE_VULKAN_FEATURE}"
POKY_DEFAULT_DISTRO_FEATURES_append_mx8  = " jailhouse"

DISTRO_FEATURES_append_mx8 = " virtualization"

INHERIT_remove = "uninative"

PACKAGECONFIG_append_pn-gstreamer1.0-plugins-ugly = " x264"
```

## conf/distro/mod-rbz-xwayland.conf
```bitbake
# RBZ DISTRO for Wayland with X11

include conf/distro/include/rbz-imx-base.inc
include conf/distro/include/rbz-imx-preferred-env.inc

DISTRO = "mod-rbz-xwayland"

# Remove conflicting backends
DISTRO_FEATURES:remove = "directfb "
DISTRO_FEATURES:append = " x11 wayland pam"
```

## conf/layer.conf
```bitbake
# We have a conf and classes directory, add to BBPATH
BBPATH .= ":${LAYERDIR}"

# We have recipes-* directories, add to BBFILES
BBFILES += "${LAYERDIR}/recipes-*/*/*.bb \
         ${LAYERDIR}/recipes-*/*/*.bbappend"

BBFILE_COLLECTIONS += "rbz"
BBFILE_PATTERN_rbz = "^${LAYERDIR}/"
BBFILE_PRIORITY_rbz = "50"
LAYERVERSION_rbz = "1"
LAYERSERIES_COMPAT_rbz = "mickledore nanbield"

# Create a mirror for unreliable packages
MIRRORS += "http://sourceforge.net/.* http://www.nxp.com/lgfiles/updates/other"

# FIXME: Drop these lines when the external layers are marked compatible
LAYERSERIES_COMPAT_chromium-browser-layer:append = " langdale mickledore nanbield"
LAYERSERIES_COMPAT_imx-demo:append = " mickledore nanbield"

# Define new EULAs and add them to the list defined in meta-freescale.
# See fsl-eula-unpack.bbclass.
FSL_EULA_FILE_MD5SUM_LA_OPT_NXP_SOFTWARE_LICENSE_V49 = "2827219e81f28aba7c6a569f7c437fa7"
FSL_EULA_FILE_MD5SUM_LA_OPT_NXP_SOFTWARE_LICENSE_V53 = "44a8052c384584ba09077e85a3d1654f"

FSL_EULA_FILE_MD5SUMS:append = " \
    ${FSL_EULA_FILE_MD5SUM_LA_OPT_NXP_SOFTWARE_LICENSE_V49} \
    ${FSL_EULA_FILE_MD5SUM_LA_OPT_NXP_SOFTWARE_LICENSE_V53} \
"

# FIXME: Drop xxd if/when xxd-native can be used instead
HOSTTOOLS_NONFATAL:append = " xxd cert-to-efi-sig-list"

# optee is no longer a valid distro feature. Use machine feature to remove, like this:
# MACHINE_FEATURES:remove = "optee"
# DEPRECATED: The ability to remove optee from the build is deprecated and
# will be removed in some future release.

MACHINE_USES_VIVANTE_KERNEL_DRIVER_MODULE ?= "0"

# Overrides for imx-base.inc
IMX_DEFAULT_BSP = "nxp"

# The default bootloader is set to -fslc in
# meta-freescale/cond/machine/include/imx-base.inc, so we must
# override it here.
IMX_DEFAULT_BOOTLOADER:imx-nxp-bsp = "u-boot-imx"

UBOOT_MAKE_TARGET:pn-u-boot-imx:mx6-nxp-bsp = "u-boot.imx"
UBOOT_MAKE_TARGET:pn-u-boot-imx:mx7-nxp-bsp = "u-boot.imx"
UBOOT_SUFFIX:pn-u-boot-imx:mx6-nxp-bsp = "imx"
UBOOT_SUFFIX:pn-u-boot-imx:mx7-nxp-bsp = "imx"
UBOOT_SUFFIX:pn-u-boot-imx:mx8-nxp-bsp = "bin"
UBOOT_MAKE_TARGET:pn-u-boot-imx-mfgtool:mx6-nxp-bsp = "u-boot.imx"
UBOOT_MAKE_TARGET:pn-u-boot-imx-mfgtool:mx7-nxp-bsp = "u-boot.imx"
UBOOT_SUFFIX:pn-u-boot-imx-mfgtool:mx6-nxp-bsp = "imx"
UBOOT_SUFFIX:pn-u-boot-imx-mfgtool:mx7-nxp-bsp = "imx"
UBOOT_SUFFIX:pn-u-boot-imx-mfgtool:mx8-nxp-bsp = "bin"

IMX_DEFAULT_UBOOTTOOLS = "u-boot-imx-tools"
PREFERRED_PROVIDER_u-boot-tools-native = "${IMX_DEFAULT_UBOOTTOOLS}-native"
PREFERRED_PROVIDER_nativesdk-u-boot-tools = "nativesdk-${IMX_DEFAULT_UBOOTTOOLS}"
PREFERRED_PROVIDER_u-boot-mkimage-native = "${IMX_DEFAULT_UBOOTTOOLS}-native"
PREFERRED_PROVIDER_nativesdk-u-boot-mkimage = "nativesdk-${IMX_DEFAULT_UBOOTTOOLS}"

PREFERRED_RPROVIDER_linux-firmware-bcm4359-pcie ??= "linux-firmware"
PREFERRED_RPROVIDER_u-boot-default-env ??= "${IMX_DEFAULT_BOOTLOADER}"

MACHINE_SOCARCH_FILTER:remove = "alsa-lib gstreamer1.0 imx-codec"

# Use latest SDMA firmware from firmware-imx instead of upstream linux-firmware
MACHINE_FIRMWARE:remove:mx6-nxp-bsp      = "linux-firmware-imx-sdma-imx6q"
MACHINE_FIRMWARE:remove:mx7d-nxp-bsp     = "linux-firmware-imx-sdma-imx7d"
MACHINE_FIRMWARE:remove:mx8-nxp-bsp      = "linux-firmware-imx-sdma-imx7d"
MACHINE_FIRMWARE:append:mx6-nxp-bsp      = " firmware-imx-sdma-imx6q"
MACHINE_FIRMWARE:append:mx7-nxp-bsp      = " firmware-imx-sdma-imx7d"
# imx6ul7d doesn't have mx7 in MACHINEOVERRIDES but needs both imx6q and imx7d firmware

MACHINE_FIRMWARE:append:imx6ul7d = " firmware-imx-sdma-imx7d"
MACHINE_FIRMWARE:append:mx8-nxp-bsp      = " firmware-imx-sdma-imx7d"

MACHINE_FIRMWARE:append:mx6ulz-nxp-bsp = " firmware-imx-epdc"
MACHINE_FIRMWARE:append:mx8-nxp-bsp    = " linux-firmware-ath10k"
MACHINE_FIRMWARE:append:mx8qm-nxp-bsp  = " firmware-imx-hdmi firmware-imx-xuvi-imx8 sof-imx sof-zephyr zephyr-demo-imx"
MACHINE_FIRMWARE:append:mx8qxp-nxp-bsp = " sof-imx sof-zephyr zephyr-demo-imx"
MACHINE_FIRMWARE:append:mx8dx-nxp-bsp  = " sof-imx sof-zephyr"
MACHINE_FIRMWARE:append:mx8mnul-nxp-bsp = " firmware-imx-easrc-imx8mn"
MACHINE_FIRMWARE:remove:mx8mp-nxp-bsp  = "firmware-sof-imx"
MACHINE_FIRMWARE:append:mx8mp-nxp-bsp  = " sof-imx sof-zephyr zephyr-demo-imx"
MACHINE_FIRMWARE:remove:mx8mpul-nxp-bsp  = "firmware-sof-imx"
MACHINE_FIRMWARE:append:mx8mpul-nxp-bsp  = " sof-imx sof-zephyr"
MACHINE_FIRMWARE:append:mx8ulp-nxp-bsp = " sof-imx sof-zephyr"

# DPDK extra SDK
MACHINE_EXTRA_RRECOMMENDS:append = " ${@bb.utils.contains('MACHINE_FEATURES', 'dpdk', 'kernel-module-dpdk-extras', '', d)}"

# NXP WiFi firmware & extra Wlan SDK
MACHINE_EXTRA_RRECOMMENDS:append = " ${@bb.utils.contains('MACHINE_FEATURES', 'nxpiw416-sdio', 'nxp-wlan-sdk', '', d)}"
MACHINE_EXTRA_RRECOMMENDS:append = " ${@bb.utils.contains('MACHINE_FEATURES', 'nxpiw612-sdio', 'nxp-wlan-sdk', '', d)}"

MACHINE_FIRMWARE:append = " ${@bb.utils.contains('MACHINE_FEATURES', 'nxpwifi-all-sdio', 'firmware-nxp-wifi-all-sdio', '', d)}"
MACHINE_EXTRA_RRECOMMENDS:append = " ${@bb.utils.contains('MACHINE_FEATURES', 'nxpwifi-all-sdio', 'nxp-wlan-sdk kernel-module-nxp-wlan', '', d)}"

MACHINE_FIRMWARE:append = " ${@bb.utils.contains('MACHINE_FEATURES', 'nxpwifi-all-pcie', 'firmware-nxp-wifi-all-pcie', '', d)}"
MACHINE_EXTRA_RRECOMMENDS:append = " ${@bb.utils.contains('MACHINE_FEATURES', 'nxpwifi-all-pcie', 'nxp-wlan-sdk kernel-module-nxp-wlan', '', d)}"

# MCore Demo apps to /lib/firmware
MACHINE_EXTRA_RRECOMMENDS:append:mx7ulp-nxp-bsp  = " imx-m4-demos"
MACHINE_EXTRA_RRECOMMENDS:append:mx8mm-nxp-bsp   = " imx-m4-demos"
MACHINE_EXTRA_RRECOMMENDS:append:mx8mn-nxp-bsp   = " imx-m7-demos"
MACHINE_EXTRA_RRECOMMENDS:append:mx8mnul-nxp-bsp = " imx-m7-demos"
MACHINE_EXTRA_RRECOMMENDS:append:mx8mp-nxp-bsp   = " imx-m7-demos"
MACHINE_EXTRA_RRECOMMENDS:append:mx8mpul-nxp-bsp = " imx-m7-demos"
MACHINE_EXTRA_RRECOMMENDS:append:mx8mq-nxp-bsp   = " imx-m4-demos"
MACHINE_EXTRA_RRECOMMENDS:append:mx8qm-nxp-bsp   = " imx-m4-demos"
MACHINE_EXTRA_RRECOMMENDS:append:mx8qxp-nxp-bsp  = " imx-m4-demos"
MACHINE_EXTRA_RRECOMMENDS:append:mx8dx-nxp-bsp   = " imx-m4-demos"
MACHINE_EXTRA_RRECOMMENDS:append:mx8dxl-nxp-bsp  = " imx-m4-demos"
MACHINE_EXTRA_RRECOMMENDS:append:mx93-nxp-bsp    = " imx-m33-demos"
MACHINE_EXTRA_RRECOMMENDS:append:mx95-nxp-bsp    = " imx-m7-demos"

MACHINE_GSTREAMER_1_0_PLUGIN:mx6dl-nxp-bsp ?= "imx-gst1.0-plugin"
MACHINE_GSTREAMER_1_0_PLUGIN:mx6q-nxp-bsp ?= "imx-gst1.0-plugin"
MACHINE_GSTREAMER_1_0_PLUGIN:mx6sl-nxp-bsp ?= "imx-gst1.0-plugin"
MACHINE_GSTREAMER_1_0_PLUGIN:mx6sll-nxp-bsp ?= "imx-gst1.0-plugin"
MACHINE_GSTREAMER_1_0_PLUGIN:mx6sx-nxp-bsp ?= "imx-gst1.0-plugin"
MACHINE_GSTREAMER_1_0_PLUGIN:mx6ul-nxp-bsp ?= "imx-gst1.0-plugin"
MACHINE_GSTREAMER_1_0_PLUGIN:mx6ull-nxp-bsp ?= "imx-gst1.0-plugin"
MACHINE_GSTREAMER_1_0_PLUGIN:mx6ulz-nxp-bsp ?= "imx-gst1.0-plugin"
MACHINE_GSTREAMER_1_0_PLUGIN:mx7d-nxp-bsp ?= "imx-gst1.0-plugin"
MACHINE_GSTREAMER_1_0_PLUGIN:mx7ulp-nxp-bsp ?= "imx-gst1.0-plugin"
MACHINE_GSTREAMER_1_0_PLUGIN:mx8mm-nxp-bsp  ?= "imx-gst1.0-plugin"
MACHINE_GSTREAMER_1_0_PLUGIN:mx8mn-nxp-bsp  ?= "imx-gst1.0-plugin"
MACHINE_GSTREAMER_1_0_PLUGIN:mx8mp-nxp-bsp  ?= "imx-gst1.0-plugin"
MACHINE_GSTREAMER_1_0_PLUGIN:mx8mq-nxp-bsp  ?= "imx-gst1.0-plugin"
MACHINE_GSTREAMER_1_0_PLUGIN:mx8qm-nxp-bsp  ?= "imx-gst1.0-plugin"
MACHINE_GSTREAMER_1_0_PLUGIN:mx8qxp-nxp-bsp ?= "imx-gst1.0-plugin"
MACHINE_GSTREAMER_1_0_PLUGIN:mx8dx-nxp-bsp  ?= "imx-gst1.0-plugin"
MACHINE_GSTREAMER_1_0_PLUGIN:mx8-nxp-bsp ?= "imx-gst1.0-plugin"
MACHINE_GSTREAMER_1_0_PLUGIN:mx9-nxp-bsp ?= "imx-gst1.0-plugin"

IMX_DEFAULT_KERNEL:mx6ulz-nxp-bsp = "linux-imx"

OPTEE_BOOT_IMAGE:mx6-nxp-bsp ?= "tee.bin uTee-${OPTEE_BIN_EXT}"
OPTEE_BOOT_IMAGE:mx7-nxp-bsp ?= "tee.bin uTee-${OPTEE_BIN_EXT}"
OPTEE_BOOT_IMAGE:mx8-nxp-bsp ?= "tee.bin"

IMAGE_INSTALL:append = " \
    ${@bb.utils.contains('COMBINED_FEATURES', 'jailhouse', 'jailhouse', '', d)} \
    ${@bb.utils.contains('MACHINE_FEATURES', 'optee', 'packagegroup-fsl-optee-imx', '', d)} \
"

# To add a new array override for a specific upstream machine, set the
# array value with a variable, then set the default variable value to
# UNSUPPORTED and the machine-specific variable value as required.
# For example:
#   UBOOT_CONFIG[fspi] = "${UBOOT_CONFIG_FSPI}"
#   UBOOT_CONFIG_FSPI                   = "UNSUPPORTED"
#   UBOOT_CONFIG_FSPI:imx8dxl-ddr3l-evk = "${UBOOT_CONFIG_BASENAME}_fspi_defconfig"

MACHINE_FEATURES_IMX_REMOVALS ?= "mrvl8997"
MACHINE_FEATURES:remove        = "${MACHINE_FEATURES_IMX_REMOVALS}"

IMXBOOT_TARGETS:append:mx8m-nxp-bsp = \
    "${@bb.utils.contains('MACHINE_FEATURES', 'optee stmm', ' flash_evk_stmm_capsule', \
                                                            '', d)}"

PREFERRED_VERSION_libgpiod = "1.6.4"
```

## conf/machine/mod_imx8m_mini.conf
```bitbake
#@TYPE: Machine
#@NAME: RBZ MOD_IMX8M_MINI Board
#@SOC: i.MX8MM
#@DESCRIPTION: Machine configuration for RBZ MOD_IMX8M_MINI BOARD
#@MAINTAINER: Carlos Amor <camor@rbz.es>

MACHINEOVERRIDES =. "mx8mm:"

# FIXME: u-boot-imx should be converted to `binman` and then we can
# avoid this specific overrides and handle it in a generic way.
MACHINEOVERRIDES =. "${@bb.utils.contains('IMX_DEFAULT_BOOTLOADER', 'u-boot-imx', '', 'imx-boot-container:', d)}"

require conf/machine/include/imx-base.inc
require conf/machine/include/arm/armv8a/tune-cortexa53.inc

# Mainline BSP defaults to "generic" cortexa53 configuration,
# adjust it here to include crypto extension which enables
# inline NEON and FPU code generation
DEFAULTTUNE:use-mainline-bsp = "cortexa53-crypto"

# NXP BSP can consume proprietary jailhouse and Marvell drivers
# OP-TEE is also applicable to NXP BSP, mainline BSP seems not to have
# a full support for it yet.
MACHINE_FEATURES:append:use-nxp-bsp = " optee jailhouse "

PREFERRED_PROVIDER:virtual/kernel = "linux-imx-rbz"
PREFERRED_PROVIDER:virtual/kernel:use-mainline-bsp ??= "linux-fslc"

KERNEL_DEVICETREE_BASENAME = "mod-imx8m-mini"
KERNEL_DEVICETREE:append:use-nxp-bsp = " \
                     rbz/mod-imx8m-mini.dtb \
                     rbz/rbz-carrier-basic-imx8m-mini-lvds.dtb \
                     rbz/rbz-carrier-basic-imx8m-mini-hdmi.dtb \
"
KERNEL_IMAGETYPE = "Image"
RDEPENDS:${KERNEL_PACKAGE_NAME}-base = ""

# Set u-boot DTB
UBOOT_DTB_NAME = "mod-imx8m-mini.dtb"

IMX_DEFAULT_BOOTLOADER:use-nxp-bsp = "u-boot-imx"
IMX_DEFAULT_BOOTLOADER:use-mainline-bsp = "u-boot-fslc"

UBOOT_SUFFIX = "bin"

UBOOT_CONFIG ??= "sd"
UBOOT_CONFIG_BASENAME = "mod_imx8m_mini"
UBOOT_CONFIG[fspi] = "${UBOOT_CONFIG_BASENAME}_fspi_defconfig"
UBOOT_CONFIG[sd] = "${UBOOT_CONFIG_BASENAME}_defconfig"

BOOT_SCRIPTS = "boot.scr:boot.scr"

IMAGE_BOOT_FILES:append = " \
    boot.scr;boot.scr \
"

SPL_BINARY = "spl/u-boot-spl.bin"

ATF_PLATFORM = "imx8mm"
ATF_LOAD_ADDR = "0x920000"

# Extra firmware package name, that is required to build boot container for fslc bsp
IMX_EXTRA_FIRMWARE = "firmware-imx-8m"

IMXBOOT_TARGETS = \
    "${@bb.utils.contains('UBOOT_CONFIG', 'fspi', '${IMXBOOT_TARGETS_BASENAME}_flexspi', \
                                                  '${IMXBOOT_TARGETS_BASENAME}', d)}"

IMX_BOOT_SOC_TARGET = "iMX8MM"

# Set DDR FIRMWARE
DDR_FIRMWARE_NAME = " \
	lpddr4_pmu_train_1d_imem.bin \
	lpddr4_pmu_train_1d_dmem.bin \
	lpddr4_pmu_train_2d_imem.bin \
	lpddr4_pmu_train_2d_dmem.bin \
"

IMXBOOT_TARGETS_BASENAME = "flash_evk"

# Set Serial console
SERIAL_CONSOLES = "115200;ttymxc2"

IMXBOOT_TARGETS += "${IMXBOOT_TARGETS_BASENAME}_flexspi"

LOADADDR = ""
UBOOT_SUFFIX = "bin"
UBOOT_MAKE_TARGET = "all"
IMX_BOOT_SEEK = "33"

OPTEE_BIN_EXT = "8mm"
TEE_LOAD_ADDR = "0xbe000000"

# Add additional firmware
MACHINE_FIRMWARE:append = " firmware-imx-sdma-imx7d firmware-imx-easrc-imx8mn linux-firmware-imx-sdma-imx7d"
```

## conf/machine/mod_imx8m_nano.conf
```bitbake
#@TYPE: Machine
#@NAME: RBZ MOD_IMX8M_NANO Board
#@SOC: i.MX8MN
#@DESCRIPTION: Machine configuration for RBZ MOD_IMX8M_NANO BOARD
#@MAINTAINER: Carlos Amor <camor@rbz.es>

#MACHINEOVERRIDES =. "imx-boot-container:mx8:mx8m:mx8mn:use-nxp-bsp:mx8m-generic-bsp:"

MACHINEOVERRIDES =. "mx8mn:"

# FIXME: u-boot-imx should be converted to `binman` and then we can
# avoid this specific overrides and handle it in a generic way.
MACHINEOVERRIDES =. "${@bb.utils.contains('IMX_DEFAULT_BOOTLOADER', 'u-boot-imx', '', 'imx-boot-container:', d)}"

IMX_DEFAULT_BSP ?= "nxp"

require conf/machine/include/imx-base.inc
require conf/machine/include/arm/armv8a/tune-cortexa53.inc

# Mainline BSP defaults to "generic" cortexa53 configuration,
# adjust it here to include crypto extension which enables
# inline NEON and FPU code generation
DEFAULTTUNE:use-mainline-bsp = "cortexa53-crypto"

# NXP BSP can consume proprietary jailhouse and Marvell drivers
# OP-TEE is also applicable to NXP BSP, mainline BSP seems not to have
# a full support for it yeMACHINE_FEATURES:append:use-nxp-bsp = " optee jailhouse "
MACHINE_FEATURES:append:use-nxp-bsp = " optee jailhouse "
PREFERRED_PROVIDER:virtual/kernel = "linux-imx-rbz"
PREFERRED_PROVIDER:virtual/kernel:use-mainline-bsp ??= "linux-fslc"

KERNEL_DEVICETREE_BASENAME = "mod-imx8m-nano"
KERNEL_DEVICETREE:append:use-nxp-bsp = " \
                     rbz/mod-imx8m-nano.dtb \
                     rbz/rbz-carrier-basic-imx8m-nano.dtb \ 
"
KERNEL_IMAGETYPE = "Image"
RDEPENDS:${KERNEL_PACKAGE_NAME}-base = ""

# Set u-boot DTB
UBOOT_DTB_NAME = "mod-imx8m-nano.dtb"

IMX_DEFAULT_BOOTLOADER:use-nxp-bsp = "u-boot-imx"
IMX_DEFAULT_BOOTLOADER:use-mainline-bsp = "u-boot-fslc"


UBOOT_SUFFIX = "bin"

UBOOT_CONFIG ??= "sd"
UBOOT_CONFIG_BASENAME = "mod_imx8m_nano"
UBOOT_CONFIG[fspi] = "${UBOOT_CONFIG_BASENAME}_defconfig"
UBOOT_CONFIG[sd] = "${UBOOT_CONFIG_BASENAME}_defconfig"

BOOT_SCRIPTS = "boot.scr:boot.scr"

IMAGE_BOOT_FILES:append = " \
    boot.scr;boot.scr \
"

SPL_BINARY = "spl/u-boot-spl.bin"

ATF_PLATFORM = "imx8mn"
ATF_LOAD_ADDR = "0x960000"

# Extra firmware package name, that is required to build boot container for fslc bsp
IMX_EXTRA_FIRMWARE = "firmware-imx-8m"

IMXBOOT_TARGETS = \
    "${@bb.utils.contains('UBOOT_CONFIG', 'fspi', '${IMXBOOT_TARGETS_BASENAME}_flexspi', \
                                                  '${IMXBOOT_TARGETS_BASENAME}', d)}"

IMX_BOOT_SOC_TARGET = "iMX8MN"

# Set DDR FIRMWARE
DDR_FIRMWARE_NAME = " \
	lpddr4_pmu_train_1d_dmem.bin \
	lpddr4_pmu_train_1d_imem.bin \
	lpddr4_pmu_train_2d_dmem.bin \
	lpddr4_pmu_train_2d_imem.bin \
"

IMXBOOT_TARGETS_BASENAME = "flash_evk"

# Set Serial console
SERIAL_CONSOLES = "115200;ttymxc2"

IMXBOOT_TARGETS += "${IMXBOOT_TARGETS_BASENAME}_flexspi"

LOADADDR = ""
UBOOT_SUFFIX = "bin"
UBOOT_MAKE_TARGET = "all"
IMX_BOOT_SEEK = "32"

OPTEE_BIN_EXT = "8mn"
TEE_LOAD_ADDR = "0x56000000"

SOC_ATF_BOOT_UART_BASE = ""
SOC_ATF_BOOT_UART_BASE:mx8m-generic-bsp = "0x30880000"
ATF_BOOT_UART_BASE ?= "${SOC_ATF_BOOT_UART_BASE}" 

# Add additional firmware
MACHINE_FIRMWARE:append = " firmware-imx-sdma-imx7d firmware-imx-easrc-imx8mn linux-firmware-imx-sdma-imx7d"
```
